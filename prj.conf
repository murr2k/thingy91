## CMakeLists.txt
```
# SPDX-License-Identifier: Apache-2.0

cmake_minimum_required(VERSION 3.20.0)

find_package(Zephyr REQUIRED HINTS $ENV{ZEPHYR_BASE})
project(thingy91_demo)

# Source files
target_sources(app PRIVATE
    src/main.c
    src/sensors/sensor_manager.c
    src/sensors/environmental_sensor.c
    src/sensors/motion_sensor.c
    src/connectivity/cellular_manager.c
    src/connectivity/mqtt_client.c
    src/data/data_processor.c
    src/data/data_buffer.c
    src/ui/led_controller.c
    src/ui/button_handler.c
    src/power/power_manager.c
    src/config/config_manager.c
)

# Include directories
target_include_directories(app PRIVATE
    src/
    src/sensors/
    src/connectivity/
    src/data/
    src/ui/
    src/power/
    src/config/
)

# Add compiler definitions
target_compile_definitions(app PRIVATE
    -DCONFIG_THINGY91_DEMO=1
)
```

## Kconfig
```
# Copyright (c) 2024 Nordic Semiconductor ASA
# SPDX-License-Identifier: Apache-2.0

menu "Nordic Thingy91 Demo Configuration"

config THINGY91_DEMO_SENSOR_INTERVAL_MS
    int "Sensor reading interval in milliseconds"
    default 5000
    range 100 3600000
    help
      Interval between sensor readings in milliseconds.
      Minimum 100ms, maximum 1 hour (3600000ms).

config THINGY91_DEMO_MQTT_KEEPALIVE
    int "MQTT keepalive interval in seconds"
    default 60
    range 10 65535
    help
      MQTT keepalive interval in seconds.
      This determines how often MQTT ping messages are sent.

config THINGY91_DEMO_DATA_BUFFER_SIZE
    int "Data buffer size (number of entries)"
    default 100
    range 10 1000
    help
      Maximum number of sensor data entries to buffer.
      Used when network connectivity is unavailable.

config THINGY91_DEMO_ENABLE_SENSOR_SIMULATION
    bool "Enable sensor data simulation"
    default y if BOARD_QEMU_X86
    default n
    help
      Enable simulation of sensor data when real sensors
      are not available (e.g., in emulation environments).

config THINGY91_DEMO_ENABLE_POWER_MANAGEMENT
    bool "Enable advanced power management"
    default y
    depends on PM
    help
      Enable advanced power management features including
      automatic sleep modes and battery monitoring.

config THINGY91_DEMO_ENABLE_LED_ANIMATIONS
    bool "Enable LED animations"
    default y
    help
      Enable LED animation patterns for status indication.
      Disable to reduce power consumption.

config THINGY91_DEMO_MAX_LOG_ENTRIES
    int "Maximum log entries in flash"
    default 1000
    range 100 10000
    depends on LOG_BACKEND_FS
    help
      Maximum number of log entries to store in flash memory.

config THINGY91_DEMO_CONFIG_VERSION
    int "Configuration version number"
    default 1
    help
      Configuration structure version for migration support.

config THINGY91_DEMO_ENABLE_DIAGNOSTICS
    bool "Enable system diagnostics"
    default y
    help
      Enable comprehensive system diagnostics and health monitoring.

config THINGY91_DEMO_WATCHDOG_TIMEOUT_MS
    int "Watchdog timeout in milliseconds"
    default 30000
    range 1000 120000
    depends on WATCHDOG
    help
      Watchdog timeout period in milliseconds.

endmenu
```

## west.yml
```
# Copyright (c) 2024 Nordic Semiconductor ASA
# SPDX-License-Identifier: Apache-2.0
# Updated for NCS v2.9.1 + SoftSIM Phase 2 Integration

manifest:
  version: "0.13"

  defaults:
    remote: ncs

  remotes:
    - name: ncs
      url-base: https://github.com/nrfconnect
    - name: onomondo
      url-base: https://github.com/onomondo

  projects:
    # Nordic Connect SDK v2.9.1 components (matching working baseline)
    - name: sdk-nrf
      revision: v2.9.1
      path: nrf
    - name: sdk-zephyr
      revision: v3.7.99-ncs1-1
      path: zephyr  
    - name: sdk-mcuboot
      revision: v2.0.99-ncs6-3
      path: bootloader/mcuboot
    - name: sdk-mbedtls
      revision: v3.5.0-ncs6-2
      path: modules/crypto/mbedtls
    - name: sdk-nrfxlib
      revision: v2.9.1
      path: nrfxlib
    - name: sdk-trusted-firmware-m
      revision: v2.0.0-ncs4-3
      path: modules/tee/tf-m/trusted-firmware-m
    
    # Onomondo SoftSIM integration (Phase 2)
    # Using v5.1.0 which includes NCS v2.9.1 support (commit a393f70)
    - name: nrf-softsim
      remote: onomondo
      revision: v5.1.0
      path: modules/lib/onomondo-softsim

  self:
    path: asset_tracker_v2_source
```

## prj.conf
```kconfig
### Onomondo SoftSIM ###
CONFIG_SOFTSIM=y
CONFIG_SOFTSIM_AUTO_INIT=y
CONFIG_SOFTSIM_DEBUG=n
CONFIG_SOFTSIM_STATIC_PROFILE_ENABLE=y
# Real Onomondo profile for ICCID: 89457300000032481957
CONFIG_SOFTSIM_STATIC_PROFILE="7510f6d3a7c479a940b2741ffcd92e940c6191b4ecb8634a4ed2eae45d7db5865773db370955be09050baf2e9b104f0340bc233390b6fb6d484b52ab2a7c0310a348f591916033272fa00c3148e5dae2ae67b9a37b9e517c51950e3980cf966c4e7743be5f0f1dbf189b99d43e629bf4e1b888102f39965de44b203a03b53159d008816f44d10e87e30f4120e18dc0df941078d1623a2ccb64f7471babef29a13ed7fa84815e5f732bc8f6ce015bfa8536acc87f96a78e88888869ef0969565b2061a1d0bc364f2e443544066321305e59003ee1d63f7349f126bfd5a51a409daf89949e3602b90cfb5ddbba4f0749d10ca4f8235ef5e5232b5925e3db696a434bc38864534badb0bd002f882945592408e1e48e6e0f78fae0315b6a44b0f7c9d9173771bb057eaf34ac933610917d5cd811551fa5dd5e04e3eb92fab1df5294e25e91223a9fb49f"
### Onomondo SoftSIM ###

# Log Configurations
CONFIG_DEBUG=n
CONFIG_LOG=y
CONFIG_NRF_MODEM_LOG=n

# General Configurations
CONFIG_LOG_BUFFER_SIZE=5000
CONFIG_LOG_PROCESS_TRIGGER_THRESHOLD=5
CONFIG_LOG_DEFAULT_LEVEL=1

# Modem Configurations
CONFIG_NRF_MODEM_LIB=y

# NET Configurations
CONFIG_NETWORKING=y
CONFIG_NET_SOCKETS=y
CONFIG_NET_NATIVE=n
CONFIG_NET_SOCKETS_OFFLOAD=y
CONFIG_POSIX_API=y

# LTE Configurations
CONFIG_LTE_LINK_CONTROL=y
CONFIG_LTE_LC_PSM_MODULE=y
CONFIG_LTE_LC_EDRX_MODULE=y

# AT host library
CONFIG_SERIAL=y
CONFIG_AT_HOST_LIBRARY=y
CONFIG_UART_INTERRUPT_DRIVEN=y

# SoftSIM required dependencies  
CONFIG_NVS=y
CONFIG_FLASH=y
CONFIG_FLASH_MAP=y
CONFIG_FLASH_PAGE_LAYOUT=y
CONFIG_MPU_ALLOW_FLASH_WRITE=y
CONFIG_BUILD_WITH_TFM=y

# Reduce the size of TF-M by disabling the PS
CONFIG_TFM_PARTITION_PROTECTED_STORAGE=n
CONFIG_PSA_CRYPTO_DRIVER_CC3XX=n

# Reduce the size of the TF-M partition
# when combined with static partitioning
CONFIG_PM_PARTITION_SIZE_TFM=0x10000

# The bootloader adds a small mcuboot_pad partition,
# whose size must be subtracted from the TF-M partition
#CONFIG_BOOTLOADER_MCUBOOT=y
#CONFIG_PM_PARTITION_SIZE_TFM=0xFE00
```

## boards/thingy91_nrf9160_ns.overlay
```dts
/*
 * Copyright (c) 2024 Nordic Semiconductor ASA
 *
 * SPDX-License-Identifier: Apache-2.0
 */

/* Minimal device tree overlay for SoftSIM functionality */

/* Enable ADC for basic functionality if needed */
&adc {
	status = "okay";
};
```

## src/main.c
```c
/*
 * Copyright (c) 2024 Nordic Semiconductor ASA
 *
 * SPDX-License-Identifier: Apache-2.0
 */

#include <zephyr/kernel.h>
#include <zephyr/logging/log.h>
#include <zephyr/device.h>
#include <zephyr/devicetree.h>
#include <dk_buttons_and_leds.h>

#include "sensors/sensor_manager.h"
#include "connectivity/cellular_manager.h"
#include "connectivity/mqtt_client.h"
#include "data/data_processor.h"
#include "ui/led_controller.h"
#include "ui/button_handler.h"
#include "power/power_manager.h"
#include "config/config_manager.h"

LOG_MODULE_REGISTER(main, CONFIG_LOG_DEFAULT_LEVEL);

/* Application states */
enum app_state {
    APP_STATE_INIT,
    APP_STATE_CELLULAR_CONNECTING,
    APP_STATE_MQTT_CONNECTING,
    APP_STATE_RUNNING,
    APP_STATE_ERROR,
    APP_STATE_SLEEP
};

static enum app_state current_state = APP_STATE_INIT;
static struct k_work_delayable main_work;
static struct k_work_delayable sensor_work;

/* Forward declarations */
static void main_work_handler(struct k_work *work);
static void sensor_work_handler(struct k_work *work);
static void state_machine_update(void);
static void handle_sensor_data(const struct sensor_data *data);

/* Work handlers */
static void main_work_handler(struct k_work *work)
{
    state_machine_update();
    
    /* Schedule next state machine update */
    k_work_schedule(&main_work, K_SECONDS(1));
}

static void sensor_work_handler(struct k_work *work)
{
    struct sensor_data data;
    int ret;
    
    if (current_state != APP_STATE_RUNNING) {
        goto schedule_next;
    }
    
    /* Read sensor data */
    ret = sensor_manager_read_all(&data);
    if (ret == 0) {
        handle_sensor_data(&data);
    } else {
        LOG_WRN("Failed to read sensor data: %d", ret);
        led_controller_set_error();
    }

schedule_next:
    /* Schedule next sensor reading */
    k_work_schedule(&sensor_work, K_MSEC(CONFIG_THINGY91_DEMO_SENSOR_INTERVAL_MS));
}

static void handle_sensor_data(const struct sensor_data *data)
{
    char json_buffer[512];
    int ret;
    
    LOG_INF("Sensor data - Temp: %.2f°C, Humidity: %.2f%%, Pressure: %.2f hPa",
            data->temperature, data->humidity, data->pressure);
    LOG_INF("Motion - X: %.2f, Y: %.2f, Z: %.2f", 
            data->accel_x, data->accel_y, data->accel_z);
    
    /* Process and format data */
    ret = data_processor_format_json(data, json_buffer, sizeof(json_buffer));
    if (ret < 0) {
        LOG_ERR("Failed to format sensor data as JSON: %d", ret);
        return;
    }
    
    /* Buffer data for transmission */
    ret = data_processor_buffer_data(json_buffer);
    if (ret < 0) {
        LOG_ERR("Failed to buffer data: %d", ret);
        return;
    }
    
    /* Attempt to transmit if connected */
    if (mqtt_client_is_connected()) {
        ret = mqtt_client_publish_data(json_buffer);
        if (ret == 0) {
            led_controller_indicate_transmission();
            LOG_INF("Data transmitted successfully");
        } else {
            LOG_WRN("Failed to transmit data: %d", ret);
        }
    } else {
        LOG_INF("MQTT not connected, data buffered");
        led_controller_indicate_buffering();
    }
}

static void state_machine_update(void)
{
    enum app_state next_state = current_state;
    
    switch (current_state) {
    case APP_STATE_INIT:
        if (cellular_manager_is_ready()) {
            next_state = APP_STATE_CELLULAR_CONNECTING;
            led_controller_set_connecting();
        }
        break;
        
    case APP_STATE_CELLULAR_CONNECTING:
        if (cellular_manager_is_connected()) {
            next_state = APP_STATE_MQTT_CONNECTING;
        } else if (cellular_manager_has_error()) {
            next_state = APP_STATE_ERROR;
            led_controller_set_error();
        }
        break;
        
    case APP_STATE_MQTT_CONNECTING:
        if (mqtt_client_is_connected()) {
            next_state = APP_STATE_RUNNING;
            led_controller_set_connected();
            LOG_INF("Application ready - starting sensor readings");
        } else if (mqtt_client_has_error()) {
            next_state = APP_STATE_ERROR;
            led_controller_set_error();
        }
        break;
        
    case APP_STATE_RUNNING:
        if (!cellular_manager_is_connected()) {
            next_state = APP_STATE_CELLULAR_CONNECTING;
            led_controller_set_connecting();
        } else if (!mqtt_client_is_connected()) {
            next_state = APP_STATE_MQTT_CONNECTING;
        }
        break;
        
    case APP_STATE_ERROR:
        /* Stay in error state until manual reset */
        break;
        
    case APP_STATE_SLEEP:
        /* Wake up handling would be implemented here */
        break;
    }
    
    if (next_state != current_state) {
        LOG_INF("State transition: %d -> %d", current_state, next_state);
        current_state = next_state;
    }
}

static void button_callback(uint32_t button_state, uint32_t has_changed)
{
    if (has_changed & DK_BTN1_MSK) {
        if (button_state & DK_BTN1_MSK) {
            LOG_INF("Button 1 pressed - triggering immediate sensor reading");
            k_work_reschedule(&sensor_work, K_NO_WAIT);
        }
    }
    
    if (has_changed & DK_BTN2_MSK) {
        if (button_state & DK_BTN2_MSK) {
            LOG_INF("Button 2 pressed - toggling power mode");
            power_manager_toggle_power_mode();
        }
    }
}

int main(void)
{
    int ret;
    
    LOG_INF("Nordic Thingy91 Demo Application Starting");
    LOG_INF("Build time: " __DATE__ " " __TIME__);
    
    /* Initialize DK library for buttons and LEDs */
    ret = dk_buttons_init(button_callback);
    if (ret) {
        LOG_ERR("Failed to initialize buttons: %d", ret);
        return ret;
    }
    
    ret = dk_leds_init();
    if (ret) {
        LOG_ERR("Failed to initialize LEDs: %d", ret);
        return ret;
    }
    
    /* Initialize application modules */
    ret = config_manager_init();
    if (ret) {
        LOG_ERR("Failed to initialize config manager: %d", ret);
        return ret;
    }
    
    ret = power_manager_init();
    if (ret) {
        LOG_ERR("Failed to initialize power manager: %d", ret);
        return ret;
    }
    
    ret = led_controller_init();
    if (ret) {
        LOG_ERR("Failed to initialize LED controller: %d", ret);
        return ret;
    }
    
    ret = data_processor_init();
    if (ret) {
        LOG_ERR("Failed to initialize data processor: %d", ret);
        return ret;
    }
    
    ret = sensor_manager_init();
    if (ret) {
        LOG_ERR("Failed to initialize sensor manager: %d", ret);
        return ret;
    }
    
    ret = cellular_manager_init();
    if (ret) {
        LOG_ERR("Failed to initialize cellular manager: %d", ret);
        return ret;
    }
    
    ret = mqtt_client_init();
    if (ret) {
        LOG_ERR("Failed to initialize MQTT client: %d", ret);
        return ret;
    }
    
    /* Initialize work items */
    k_work_init_delayable(&main_work, main_work_handler);
    k_work_init_delayable(&sensor_work, sensor_work_handler);
    
    /* Start the application */
    led_controller_set_initializing();
    LOG_INF("Application initialized successfully");
    
    /* Start main state machine */
    k_work_schedule(&main_work, K_SECONDS(1));
    
    /* Start sensor readings */
    k_work_schedule(&sensor_work, K_SECONDS(5));
    
    return 0;
}
```
