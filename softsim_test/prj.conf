## CMakeLists.txt
```
cmake_minimum_required(VERSION 3.20.0)

# Explicitly add onomondo-softsim module
list(APPEND ZEPHYR_EXTRA_MODULES ${CMAKE_CURRENT_SOURCE_DIR}/../../../ncs/v3.1.0/modules/lib/onomondo-softsim)

# Force use of our custom static partition map
set(PM_STATIC_YML_FILE ${CMAKE_CURRENT_SOURCE_DIR}/pm_static.yml CACHE INTERNAL "")

find_package(Zephyr REQUIRED HINTS $ENV{ZEPHYR_BASE})
project(softsim_working)

target_sources(app PRIVATE src/main.c)
```

## prj.conf
```kconfig
# Onomondo SoftSIM Configurations
CONFIG_SOFTSIM=y
CONFIG_SOFTSIM_AUTO_INIT=y
CONFIG_SOFTSIM_DEBUG=y
CONFIG_SOFTSIM_STATIC_PROFILE_ENABLE=y
CONFIG_SOFTSIM_STATIC_PROFILE="011208432405021027699802149854370000002384911803205CA22AA180CE1B6DAB8693F12C9964EB0420A3680546ADE394C5E8851BAC6403FA9105201B5CB6F7F4A4DEB2FDAC35019CF3D0E6062073C1E843AF2AB5B3E0401F49AFB9BE2A0808363730320b1035303433393230390a2039343839323232363932363034343232"

# Log Configurations  
CONFIG_DEBUG=y
CONFIG_LOG=y
CONFIG_NRF_MODEM_LOG=y
CONFIG_LOG_BUFFER_SIZE=8000
CONFIG_LOG_PROCESS_TRIGGER_THRESHOLD=10
CONFIG_LOG_DEFAULT_LEVEL=3

# RTT Logging
CONFIG_USE_SEGGER_RTT=y
CONFIG_RTT_CONSOLE=y
CONFIG_LOG_BACKEND_RTT=y

# UART Logging for serial output
CONFIG_LOG_BACKEND_UART=y
CONFIG_CONSOLE=y
CONFIG_UART_CONSOLE=y
CONFIG_SERIAL=y

# Modem Configurations
CONFIG_NRF_MODEM_LIB=y

# NET Configurations
CONFIG_NETWORKING=y
CONFIG_NET_SOCKETS=y
CONFIG_NET_NATIVE=n
CONFIG_NET_SOCKETS_OFFLOAD=y
CONFIG_POSIX_API=y

# LTE Configurations
CONFIG_LTE_LINK_CONTROL=y
CONFIG_LTE_LC_PSM_MODULE=y
CONFIG_LTE_LC_EDRX_MODULE=y

# AT host library
CONFIG_SERIAL=y
CONFIG_AT_HOST_LIBRARY=y
CONFIG_UART_INTERRUPT_DRIVEN=y

# NVS Configurations
CONFIG_NVS=y
CONFIG_NVS_LOG_LEVEL_ERR=y
CONFIG_PM_PARTITION_SIZE_NVS_STORAGE=0x8000

# Flash Configurations
CONFIG_FLASH=y
CONFIG_FLASH_MAP=y
CONFIG_FLASH_PAGE_LAYOUT=y
CONFIG_MPU_ALLOW_FLASH_WRITE=y

# Stack and Heap Configurations
CONFIG_MAIN_STACK_SIZE=5000
CONFIG_HEAP_MEM_POOL_SIZE=30000

# TF-M Configurations - Use Onomondo recommended sizes
CONFIG_BUILD_WITH_TFM=y
CONFIG_PM_PARTITION_SIZE_TFM=0x18000
CONFIG_PM_PARTITION_SIZE_TFM_SRAM=0xC000
CONFIG_TFM_PROFILE_TYPE_NOT_SET=y
CONFIG_TFM_LOG_LEVEL_SILENCE=y

# Reduce the size of TF-M by disabling the PS (as per Onomondo overlay)
CONFIG_TFM_PARTITION_PROTECTED_STORAGE=n
CONFIG_PSA_CRYPTO_DRIVER_CC3XX=n

# PSA Crypto Configurations
CONFIG_PSA_WANT_ALG_CBC_NO_PADDING=y
CONFIG_PSA_WANT_ALG_ECB_NO_PADDING=y
CONFIG_PSA_WANT_ALG_CMAC=y
CONFIG_PSA_WANT_KEY_TYPE_AES=y

# Libraries
CONFIG_NEWLIB_LIBC=y

# Disable predefined Thingy91 partition layouts to use custom static partition map
CONFIG_THINGY91_NO_PREDEFINED_LAYOUT=y
```

## src/main.c
```c
#include <stdio.h>
#include <string.h>

#include <nrf_modem.h>
#include <nrf_modem_at.h>

#include <modem/lte_lc.h>
#include <modem/nrf_modem_lib.h>

#include <zephyr/kernel.h>
#include <zephyr/net/socket.h>
#include <zephyr/logging/log.h>

#ifdef CONFIG_SOFTSIM
#include <nrf_softsim.h>
#endif

LOG_MODULE_REGISTER(softsim_working, LOG_LEVEL_INF);

// semaphores
K_SEM_DEFINE(lte_connected, 0, 1);

static void lte_handler(const struct lte_lc_evt *const evt);
static int server_connect(void);

static int client_fd;
static struct sockaddr_storage host_addr;
static struct k_work_delayable server_transmission_work;

static void server_transmission_work_fn(struct k_work *work)
{
  char buffer[] = "{\"message\":\"Hello from Onomondo SoftSIM with proper integration!\"}";

  int err = send(client_fd, buffer, sizeof(buffer) - 1, 0);

  if (err < 0) {
    LOG_ERR("Failed to transmit UDP packet, %d", errno);
    k_work_schedule(&server_transmission_work, K_SECONDS(2));
    return;
  }

  LOG_INF("Data sent successfully!");
  k_work_schedule(&server_transmission_work, K_SECONDS(150));
}

static void work_init(void)
{
  k_work_init_delayable(&server_transmission_work, server_transmission_work_fn);
}

static void lte_handler(const struct lte_lc_evt *const evt)
{
  switch (evt->type) {
    case LTE_LC_EVT_NW_REG_STATUS:
      if ((evt->nw_reg_status != LTE_LC_NW_REG_REGISTERED_HOME) &&
          (evt->nw_reg_status != LTE_LC_NW_REG_REGISTERED_ROAMING)) {
        break;
      }

      LOG_INF("Network registration status: %s",
              evt->nw_reg_status == LTE_LC_NW_REG_REGISTERED_HOME ? "Connected - home network" : "Connected - roaming");
      k_sem_give(&lte_connected);
      break;
    case LTE_LC_EVT_PSM_UPDATE:
      LOG_INF("PSM parameter update: TAU: %d, Active time: %d", evt->psm_cfg.tau, evt->psm_cfg.active_time);
      break;
    case LTE_LC_EVT_EDRX_UPDATE: {
      char log_buf[60];
      ssize_t len;

      len = snprintf(log_buf, sizeof(log_buf), "eDRX parameter update: eDRX: %f, PTW: %f",
                     (double)evt->edrx_cfg.edrx, (double)evt->edrx_cfg.ptw);
      if (len > 0) {
        LOG_INF("%s\n", log_buf);
      }
      break;
    }
    case LTE_LC_EVT_RRC_UPDATE:
      LOG_INF("RRC mode: %s\n", evt->rrc_mode == LTE_LC_RRC_MODE_CONNECTED ? "Connected" : "Idle");
      break;
    case LTE_LC_EVT_CELL_UPDATE:
      LOG_INF("LTE cell changed: Cell ID: %d, Tracking area: %d", evt->cell.id, evt->cell.tac);
      break;
    default:
      break;
  }
}

static void modem_connect(void)
{
  int err = lte_lc_connect_async(lte_handler);
  if (err) {
    LOG_ERR("Connecting to LTE network failed, error: %d", err);
    return;
  }
}

static void server_disconnect(void)
{
  (void)close(client_fd);
}

static int server_init(void)
{
  struct sockaddr_in *server4 = ((struct sockaddr_in *)&host_addr);

  server4->sin_family = AF_INET;
  server4->sin_port = htons(4321);

  inet_pton(AF_INET, "1.2.3.4", &server4->sin_addr);

  return 0;
}

static int server_connect(void)
{
  int err;

  client_fd = socket(AF_INET, SOCK_DGRAM, IPPROTO_UDP);
  if (client_fd < 0) {
    LOG_ERR("Failed to create UDP socket: %d\n", errno);
    err = -errno;
    goto error;
  }

  err = connect(client_fd, (struct sockaddr *)&host_addr, sizeof(struct sockaddr_in));
  if (err < 0) {
    LOG_ERR("Connect failed : %d\n", errno);
    goto error;
  }

  return 0;

error:
  server_disconnect();
  return err;
}

int main(void)
{
  LOG_INF("SoftSIM sample with proper Onomondo integration (ICCID: 89457300000032481981).");

#ifdef CONFIG_SOFTSIM
  // Explicitly initialize SoftSIM
  int err = nrf_softsim_init();
  if (err) {
    LOG_ERR("Failed to initialize SoftSIM, error: %d", err);
  } else {
    LOG_INF("SoftSIM initialized successfully");
  }
  
  // Check if SoftSIM is provisioned
  bool provisioned = nrf_softsim_check_provisioned();
  LOG_INF("SoftSIM provisioned: %s", provisioned ? "YES" : "NO");
#endif

  int32_t err_modem = nrf_modem_lib_init();
  if (err_modem) {
    LOG_ERR("Failed to initialize modem library, error: %d\n", err_modem);
  }

  work_init();

  // Select SoftSIM instead of physical SIM
  err = nrf_modem_at_printf("AT%%CSUS=2");
  if (err) {
    LOG_ERR("Failed to select SoftSIM, error: %d", err);
  } else {
    LOG_INF("SoftSIM selected");
  }

  // Configure APN for Onomondo SoftSIM
  err = nrf_modem_at_printf("AT+CGDCONT=1,\"IP\",\"onomondo\"");
  if (err) {
    LOG_ERR("Failed to set APN, error: %d", err);
  } else {
    LOG_INF("APN configured: onomondo");
  }

  modem_connect();

  LOG_INF("Waiting for LTE connect event.\n");
  do {
  } while (k_sem_take(&lte_connected, K_SECONDS(10)));

  LOG_INF("LTE connected with properly integrated SoftSIM!\n");
  err = server_init();
  if (err) {
    LOG_ERR("Not able to initialize UDP server connection\n");
    return -1;
  }

  err = server_connect();
  if (err) {
    LOG_ERR("Not able to connect to UDP server\n");
    return -1;
  }

  k_work_schedule(&server_transmission_work, K_NO_WAIT);
}
```
